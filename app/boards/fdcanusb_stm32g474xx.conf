## app/boards/fdcanusb_stm32g474xx.conf
```kconfig
# Copyright (c) 2025 Igor Knippenberg <knippenberg@filics.eu>
# SPDX-License-Identifier: Apache-2.0

CONFIG_CANNECTIVITY_USB_SELF_POWERED=n

# The two lines below are needed to reduce flash usage
CONFIG_LTO=y
CONFIG_ISR_TABLES_LOCAL_DECLARATION=y

# redirect console output to segger rtt
CONFIG_CONSOLE=y
CONFIG_USE_SEGGER_RTT=y
CONFIG_RTT_CONSOLE=y
CONFIG_LOG_BACKEND_RTT=y
CONFIG_THREAD_NAME=y
# CONFIG_LOG_MODE_DEFERRED=n
# CONFIG_LOG_MODE_IMMEDIATE=y

# CONFIG_LOG=n

CONFIG_CANNECTIVITY_USB_MANUFACTURER="mjbots"
CONFIG_CANNECTIVITY_USB_PRODUCT="fdcanusb gs_usb"
CONFIG_CANNECTIVITY_USB_VID=0x1d50
CONFIG_CANNECTIVITY_USB_PID=0x606f

CONFIG_CANNECTIVITY_LED_EVENT_MSGQ_SIZE=100
CONFIG_USB_DEVICE_GS_USB_POOL_SIZE=100

CONFIG_POLL=y

CONFIG_CLOCK_CONTROL=y
```

## boards/mjbots/fdcanusb/Kconfig.defconfig
```kconfig
# mjbots fdcanusb board configuration

# Copyright (c) 2025 Filics
# SPDX-License-Identifier: LicenseRef-Filics

if BOARD_FDCANUSB

config BOARD
	default "fdcanusb"

config SPI_STM32_INTERRUPT
	default y
	depends on SPI

endif # BOARD_FDCANUSB
```

## boards/mjbots/fdcanusb/Kconfig.fdcanusb
```kconfig
# mjbots fdcanusb board configuration

# Copyright (c) 2025 Filics
# SPDX-License-Identifier: LicenseRef-Filics

config BOARD_FDCANUSB
	bool "mjbots fdcanusb"
	select SOC_STM32G474XX
```

## boards/mjbots/fdcanusb/board.yml
```yaml
# Copyright (c) 2025 Filics
# SPDX-License-Identifier: LicenseRef-Filics

board:
  name: fdcanusb
  vendor: mjbots
  socs:
    - name: stm32g474xx
  revision:
    format: major.minor.patch
    default: "1.0.0"
    revisions:
    - name: "1.0.0"
```

## boards/mjbots/fdcanusb/fdcanusb_stm32g474xx_defconfig
```kconfig
# Copyright (c) 2025 Filics
# SPDX-License-Identifier: LicenseRef-Filics

# enable GPIO
CONFIG_GPIO=y

# Enable MPU
CONFIG_ARM_MPU=y

# Enable HW stack protection
# CONFIG_HW_STACK_PROTECTION=y
```
